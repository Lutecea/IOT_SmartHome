## build/Kconfig/arch/Kconfig
```kconfig
# Load arch Kconfig descriptions.
osource "/home/luden/zephyrproject/zephyr/arch/x86/Kconfig"
osource "/home/luden/zephyrproject/zephyr/arch/xtensa/Kconfig"
osource "/home/luden/zephyrproject/zephyr/arch/sparc/Kconfig"
osource "/home/luden/zephyrproject/zephyr/arch/riscv/Kconfig"
osource "/home/luden/zephyrproject/zephyr/arch/posix/Kconfig"
osource "/home/luden/zephyrproject/zephyr/arch/nios2/Kconfig"
osource "/home/luden/zephyrproject/zephyr/arch/mips/Kconfig"
osource "/home/luden/zephyrproject/zephyr/arch/arm64/Kconfig"
osource "/home/luden/zephyrproject/zephyr/arch/arm/Kconfig"
osource "/home/luden/zephyrproject/zephyr/arch/arc/Kconfig"
```
